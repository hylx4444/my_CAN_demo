## firmware/esp32s2/main/Kconfig.projbuild
```kconfig
# 文件作用：提供 CAN 演示工程的可配置参数菜单。
# 包含模块：热点参数、UART1 接收 GPIO、保持输入的预留 GPIO、本地模拟模式。
# 调用方式：执行 idf.py menuconfig 后进入 CAN demo configuration 菜单配置。
menu "CAN sensor / S2 Mini configuration"
    config DEMO_AP_SSID
        string "Wi-Fi hotspot SSID"
        default "CANopen-Demo"
    config DEMO_AP_PASSWORD
        string "Wi-Fi hotspot password (8..63 characters)"
        default "can-demo-123"
    config DEMO_UART_TX_GPIO
        int "Reserved UART TX GPIO (held as input in this receive-only demo)"
        range 1 18
        default 4
    config DEMO_UART_RX_GPIO
        int "UART1 RX GPIO"
        range 1 18
        default 5
    config DEMO_LOCAL_SIMULATION
        bool "Generate local fake data without F2800157 (explicitly labelled on page)"
        default n
endmenu
```

## firmware/esp32s2/sdkconfig.defaults
```kconfig
# 文件作用：为 WEMOS S2 Mini 的真实串口接收模式提供默认配置。
# 包含模块：Flash 与分区、任务栈、热点名称与密码、UART 引脚、晶振及模拟开关。
# 调用方式：首次配置时由 ESP-IDF 加载；实际晶振与 Flash 容量需按模块核对。
CONFIG_ESPTOOLPY_FLASHSIZE_4MB=y
CONFIG_PARTITION_TABLE_CUSTOM=y
CONFIG_PARTITION_TABLE_CUSTOM_FILENAME="partitions.csv"
CONFIG_ESP_MAIN_TASK_STACK_SIZE=6144
CONFIG_ESP_WIFI_SOFTAP_SUPPORT=y
CONFIG_DEMO_AP_SSID="CANopen-Demo"
CONFIG_DEMO_AP_PASSWORD="can-demo-123"
# 预留发送引脚保持输入，不驱动；本演示只通过 GPIO5 接收 157 数据。
CONFIG_DEMO_UART_TX_GPIO=4
CONFIG_DEMO_UART_RX_GPIO=5
CONFIG_XTAL_FREQ_40=y
CONFIG_XTAL_FREQ=40
# 使用板载原生 USB 提供日志，UART1 专门接收 157 数据，不占用 USB 的 GPIO19/20。
CONFIG_ESP_CONSOLE_USB_CDC=y
# 关闭本地模拟；下一行是配置工具识别的固定标记，需保留原格式。
# CONFIG_DEMO_LOCAL_SIMULATION is not set
```
